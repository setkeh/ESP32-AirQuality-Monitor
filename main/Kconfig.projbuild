## main/Kconfig.projbuild
```kconfig
menu "Wifi + OTA Configuration"

config PROJECT_NAME
    string "PROJECT_NAME"
    default "MyProject"
    help
      The Name of the application in the JSON to check for OTA Updates.

config WIFI_SSID
    string "WiFi SSID"
    default "myssid"
    help
	SSID (network name) for the example to connect to.

config WIFI_PASSWORD
    string "WiFi Password"
    default "mypassword"
    help
	    WiFi password (WPA or WPA2) for the example to use.

config FIRMWARE_UPGRADE_JSON_URL
    string "Firmware JSON URL (Don't forget the File Path)"
    default "https://10.0.0.8/ota/firmware.json"
    help
        URL of server which hosts the firmware JSON file
        image.
endmenu

menu "Grafana Loki Log Driver Configuration"

config LOKI_USERNAME
  string "LOKI USERNAME (optional)"
  default "admin"
  help
    The Username of the User to log into the loki log service.

config LOKI_PASSWORD
  string "LOKI PASSWORD (optional)"
  default "password"
  help
    The Loki Password to log into the loki log service

config LOKI_HOST
  string "LOKI HOST"
  default "127.0.0.1"
  help
    The hostname / ip address of your loki instance.

config LOKI_PORT
  string "LOKI PORT"
  default "3100"
  help
    The port you Loki instance is listening on.

config LOKI_TRANSPORT
  string "LOKI TRANSPORT"
  default "HTTPS"
  help
    The transport type you loki server is listening for HTTPS or HTTP

endmenu
```
